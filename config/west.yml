## config/west.yml
```yaml
manifest:
  remotes:
    - name: zmkfirmware
      url-base: https://github.com/zmkfirmware
    - name: telzo2000
      url-base: https://github.com/telzo2000
    - name: na-ka-no
      url-base: https://github.com/na-ka-no
  projects:
    - name: zmk
      remote: na-ka-no
      revision: for-cool642tb
      import: app/west.yml
    - name: zmk-pmw3610-driver
      remote: telzo2000
      revision: main
  self:
    path: config
```
